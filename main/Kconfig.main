## main/Kconfig.main
```kconfig
menu "General"
    config NTP_SERVER_NAME
        string "Local NTP server name"
        default "ntp-server"
        help
            used to get the time sync
    
    config TIMEZONE
        string "Timezone for this device"
        default "CET-1CEST,M3.5.0,M10.5.0/3"
        help
            Enter the timezone
    
endmenu

menu "MQTT Topics"
    config TOPIC_BASE
        string "Base mqtt topic for all the datas"
        default "HeatPump/"
        help
            Enter the topic including last slash
    
endmenu
```

## main/Kconfig.projbuild
```kconfig
menu "Project Settings"
    
    orsource "$IDF_PATH/examples/common_components/env_caps/$IDF_TARGET/Kconfig.env_caps"

    rsource "./Kconfig.main"
    rsource "./../components/wifi/Kconfig.wifi"
    rsource "./../components/thread/Kconfig.thread"
    rsource "./../components/mqttClient/Kconfig.mqtt"

    comment "Module Debugging"

    
endmenu
```

## sdkconfig.defaults
```kconfig
#
# OpenThread
#
CONFIG_OPENTHREAD_ENABLED=y
CONFIG_OPENTHREAD_DNS64_CLIENT=y
CONFIG_OPENTHREAD_SRP_CLIENT=y
CONFIG_OPENTHREAD_DNS_SERVER_ADDR="192.168.50.1"
CONFIG_LWIP_IPV4=y
CONFIG_LWIP_IPV6=y
CONFIG_LWIP_DNS_SUPPORT_MDNS_QUERIES=y


#
# Partition Table
#
CONFIG_PARTITION_TABLE_CUSTOM=y
CONFIG_PARTITION_TABLE_CUSTOM_FILENAME="partitions.csv"
CONFIG_PARTITION_TABLE_FILENAME="partitions.csv"
CONFIG_PARTITION_TABLE_OFFSET=0x8000
CONFIG_PARTITION_TABLE_MD5=y



#
# Application Rollback
#
CONFIG_BOOTLOADER_APP_ROLLBACK_ENABLE=y

#
# Serial flasher config
#
CONFIG_ESPTOOLPY_FLASHSIZE_8MB=y
CONFIG_ESPTOOLPY_FLASHSIZE="8MB"

#
# Log Level
#
CONFIG_LOG_DEFAULT_LEVEL_INFO=y
# CONFIG_LOG_DEFAULT_LEVEL_DEBUG is not set
# CONFIG_LOG_DEFAULT_LEVEL_VERBOSE is not set
CONFIG_LOG_DEFAULT_LEVEL=3
# CONFIG_LOG_MAXIMUM_EQUALS_DEFAULT is not set
# CONFIG_LOG_MAXIMUM_LEVEL_DEBUG is not set
CONFIG_LOG_MAXIMUM_LEVEL_VERBOSE=y
CONFIG_LOG_MAXIMUM_LEVEL=5
```
